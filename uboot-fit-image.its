## uboot-fit-image.its
```
/dts-v1/;

/ {
        description = "U-boot FIT image for HiFive Unleashed";
        #address-cells = <2>;

        images {
                rvirt {
                        description = "xv6";
                        data = /incbin/("kernel/kernel.bin");
                        type = "kernel";
                        arch = "riscv";
                        os = "linux";
                        load = <0x80000000>;
                        entry = <0x80000000>;
                        compression = "none";
                        hash-1 {
                                algo = "sha256";
                        };
                };

                fdt {
                        data = /incbin/("hifive_u540.dtb");
                        type = "flat_dt";
                        arch = "riscv";
                        load = <0x81f00000>;
                        compression = "none";
                        hash-1 {
                                algo = "sha256";
                        };
                };
        };

        configurations {
                default = "config-1";

                config-1 {
                        description = "HiFive Unleashed with RVirt";
                        kernel = "rvirt";
                        fdt = "fdt";
                };
        };
};
```
